## components/drivers/misc/chips/Kconfig
```kconfig
menu "ADC Chip Drivers"

config RT_USING_NADC24D
    bool "Enable NADC24D external ADC"
    default n
    depends on RT_USING_ADC && RT_USING_SPI

if RT_USING_NADC24D
    config RT_NADC24D_SPI_DEV_NAME
        string "NADC24D SPI device name"
        default "spi2"

    config RT_NADC24D_SPI_MAX_HZ
        int "NADC24D SPI max frequency (Hz)"
        default 1000000

    config RT_NADC24D_DRDY_PIN
        int "NADC24D DRDY pin (0 to disable)"
        default 0

    config RT_NADC24D_DRDY_TIMEOUT_MS
        int "NADC24D DRDY timeout (ms)"
        default 200

    config RT_NADC24D_VREF_MV
        int "NADC24D reference voltage (mV)"
        default 2400
endif

endmenu
```

## components/drivers/misc/sram/cy62157e_45zs/Kconfig
```kconfig
config RT_USING_CY62157
    bool "Using CY62157E-45ZS SRAM"
    default n
    depends on RT_USING_SRAM
    help
        Enable the CY62157E-45ZS SRAM driver skeleton.

if RT_USING_CY62157

config RT_CY62157_USE_CUSTOM_TIMING
    bool "Use custom EBI timing values"
    default y

config RT_CY62157_MCLKDIV
    int "EBI MCLK divider"
    default 1

config RT_CY62157_TCTL
    hex "EBI timing control value"
    default 0x03003318

config RT_CY62157_TEST_STRIDE
    int "Memory test stride"
    default 0x40

endif
```

## components/drivers/rtc/chips/pcf8563/Kconfig
```kconfig
config RT_USING_RTC_PCF8563
    bool "Enable PCF8563 external RTC chip driver"
    default n
    depends on RT_USING_RTC && RT_USING_I2C

if RT_USING_RTC_PCF8563
    config RT_RTC_PCF8563_I2C_BUS_NAME
        string "PCF8563 I2C bus name"
        default "i2c0"

    config RT_RTC_PCF8563_I2C_ADDR
        hex "PCF8563 I2C address (7-bit)"
        range 0x00 0x7F
        default 0x51

    config RT_RTC_PCF8563_I2C_BUS_SPEED
        int "PCF8563 I2C bus speed"
        default 100000

    config RT_RTC_PCF8563_DEV_NAME
        string "PCF8563 RTC device name"
        default "rtc"
endif
```
